## boards/shields/mwv1/Kconfig.defconfig
```kconfig
if SHIELD_MWV1_LEFT

config ZMK_KEYBOARD_NAME
    default "MWV1"

config ZMK_SPLIT_ROLE_CENTRAL
    default y

endif

if SHIELD_MWV1_LEFT || SHIELD_MWV1_RIGHT

config ZMK_SPLIT
    default y

endif
```

## boards/shields/mwv1/Kconfig.shield
```kconfig
config SHIELD_MWV1_LEFT
    def_bool $(shields_list_contains,mwv1_left)

config SHIELD_MWV1_RIGHT
    def_bool $(shields_list_contains,mwv1_right)

config SHIELD_MWV1_BLE_TEST
    def_bool $(shields_list_contains,mwv1_ble_test)
```
